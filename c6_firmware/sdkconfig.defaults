## c6_firmware/sdkconfig.defaults
```kconfig
# ESP-Hosted coprocessor firmware — ESP32-C6 on the JC-ESP32P4-M3.
#
# Must stay consistent with the P4 host config in ../sdkconfig.defaults:
# same esp_hosted version, same transport (SDIO), same bus width.
#
# The C6's SDIO slave pins are FIXED in silicon and the component's Kconfig
# range-locks them, so they need no entries here:
#     CLK=19  CMD=18  D0=20  D1=21  D2=22  D3=23
# On the P4 side those land on CLK=18 CMD=19 D0..D3=14..17 (see ../sdkconfig).

# ── Role: coprocessor, talking to an MCU host over RPC v2 ──────────────
CONFIG_ESP_HOSTED=y
CONFIG_ESP_HOSTED_CP=y
CONFIG_ESP_HOSTED_CP_FOR_MCU=y
CONFIG_ESP_HOSTED_CP_RPC_V2=y
CONFIG_ESP_HOSTED_CP_FEAT_WIFI=y

# ── Transport: SDIO slave, high speed ──────────────────────────────────
CONFIG_EH_TRANSPORT_CP_SDIO=y
CONFIG_EH_TRANSPORT_CP_SDIO_HIGH_SPEED=y
# STREAM (IDF hardware batching) rather than the component's SW_AGGR default.
# SW_AGGR packs several frames per transfer (~10x fewer bus transactions) but
# needs an ESP-IDF carrying commit 4814514, which lifts the 4092-byte SDIO
# slave send cap. IDF 6.0.1 does not have it, and the component's build-time
# guard hard-fails rather than silently degrading. Patching the shared IDF
# install (`eh.py patch-idf`) would enable it - a deliberate choice to make,
# not a side effect of this build. Revisit if sdiospeed comes back low.
CONFIG_EH_TRANSPORT_CP_SDIO_MODE_STREAM=y
# -1 = the host resets us via the chip's own EN pin (P4 GPIO54 -> C6 EN),
# rather than a separate GPIO. This matches the module's wiring.
CONFIG_EH_TRANSPORT_CP_SDIO_GPIO_RESET=-1
# Credit pool for the host->CP direction. The host must see free slave buffers
# before it writes a frame; when it does not, it backs off in
# sdio_is_write_buffer_available() with usleep(400), +400us per retry. IDF's
# usleep busy-waits below one tick but switches to vTaskDelay above it, so at
# 1000 Hz the third retry jumps straight from 800us to 2ms. That quantisation
# pinned host->air at ~518 frames/s *regardless of frame size* (2.08/4.13/6.21
# Mbit/s for 500/1000/1500 B) - a per-frame software cost, not airtime, since a
# saturated radio would have dropped frames/s as frames got bigger.
# 20 slots was not enough to stay ahead of that; more credits mean fewer trips
# through the backoff. 20 -> 64 took host->air from 6.21 to 11.87 Mbit/s.
# 64 is the knee: 128 measured 11.87 vs 11.69 Mbit/s (+1.3%), i.e. nothing, so
# the credit pool is no longer the constraint above 64 and the extra slave RAM
# buys nothing. Do not raise this further expecting throughput.
CONFIG_EH_TRANSPORT_CP_SDIO_RX_Q_SIZE=64
CONFIG_EH_TRANSPORT_CP_SDIO_TX_Q_SIZE=64

# ── Bluetooth off: this bridge is Wi-Fi only, and it keeps the image small
CONFIG_BT_ENABLED=n
# Coexistence follows BT off. It defaults on, and with no BT to arbitrate
# against it only costs Wi-Fi airtime: the coex scheduler still slices the
# radio and suppresses AMPDU aggregation for a peer that does not exist.
# Measured ceiling before this: 6.15 Mbit/s over the air against 56.58 Mbit/s
# on the SDIO bus feeding it (`sdiospeed` connected vs disconnected).
CONFIG_ESP_COEX_ENABLED=n
CONFIG_ESP_COEX_SW_COEXIST_ENABLE=n

# ── Flash / partitions (ESP32-C6-MINI-1 carries 4 MB) ──────────────────
CONFIG_ESPTOOLPY_FLASHSIZE_4MB=y
CONFIG_PARTITION_TABLE_CUSTOM=y
CONFIG_PARTITION_TABLE_CUSTOM_FILENAME="partitions_eh_cp_ota_4m.csv"

# ── Wi-Fi buffers: sized for throughput, since the whole point of this
#    bridge is moving thermal frames off the board ───────────────────────
CONFIG_ESP_WIFI_STATIC_RX_BUFFER_NUM=20
CONFIG_ESP_WIFI_DYNAMIC_RX_BUFFER_NUM=64
CONFIG_ESP_WIFI_DYNAMIC_TX_BUFFER_NUM=64
CONFIG_ESP_WIFI_AMPDU_TX_ENABLED=y
CONFIG_ESP_WIFI_TX_BA_WIN=32
CONFIG_ESP_WIFI_AMPDU_RX_ENABLED=y
CONFIG_ESP_WIFI_RX_BA_WIN=32
CONFIG_ESP_WIFI_RX_IRAM_OPT=y
CONFIG_ESP_WIFI_IRAM_OPT=y
CONFIG_ESP_WIFI_NVS_ENABLED=y
CONFIG_ESP_WIFI_ENTERPRISE_SUPPORT=n

# ── Misc ───────────────────────────────────────────────────────────────
CONFIG_ESP_DEFAULT_CPU_FREQ_MHZ_160=y
CONFIG_FREERTOS_HZ=1000
CONFIG_ESP_CACHE_MALLOC=y
CONFIG_COMPILER_OPTIMIZATION_PERF=y
```

## main/Kconfig.projbuild
```kconfig
menu "Thermal Camera"

    menu "Sensor Geometry"

        config THERMAL_WIDTH
            int "Active width (pixels)"
            default 640
            help
                Active pixel columns output by the thermal camera.

        config THERMAL_HEIGHT
            int "Active height (lines)"
            default 480
            help
                Active scan lines per frame.

        config THERMAL_FPS
            int "Delivered/advertised UVC frame rate (fps)"
            default 50
            range 1 120
            help
                Frame rate streamed to the host over UVC.  The camera drives
                VSYNC at ~50 Hz but emits two interleaved phases (even = 8-bit
                video, odd = 14-bit thermal); the parity filter delivers one
                phase, so the real output rate is half the VSYNC rate (~25 fps).

    endmenu

    menu "Interleaved Phase (A/B) Filter"

        config THERMAL_PARITY_FILTER
            bool "Enable interleaved-phase (A/B) parity filter"
            default y
            help
                The source alternates two frame phases every VSYNC at 50 Hz:
                even captures carry 8-bit visible video, odd captures carry
                14-bit thermal data.  With the filter on, only one phase is
                delivered, giving a steady ~25 fps of one consistent content
                type.  Turn off to forward every capture (~50 fps, flickering
                between the two phases).

        config THERMAL_KEEP_PARITY
            int "Default phase to keep (0 = 8-bit video, 1 = 14-bit thermal)"
            default 1
            range 0 1
            help
                Which interleaved phase to deliver by default.  Selected by
                frame CONTENT (the thermal phase uses 14-bit values >255, the
                video phase fits in 8 bits), so it never drifts.  Flip at
                runtime via the A/B switch ('A'=video, 'B'=thermal, 'T'=toggle).

    endmenu

    menu "Framing Signal Polarity"

        comment "Frames complete on the VSYNC edge. If NO frames arrive"
        comment "(serial log: finished=0), flip VSYNC invert. These can also"
        comment "be swept live from the console: V key = VSYNC, D key = DE mode."

        config THERMAL_VSYNC_INVERT
            bool "Invert VSYNC polarity"
            default y
            help
                The IDF DVP driver normally wires VSYNC with GPIO-matrix
                inversion (=y here).  If the controller never detects a frame
                boundary (on_trans_finished never fires, log shows finished=0),
                flip this.  Default n = no inversion, which is the opposite of
                the driver default and the more common case for free-running
                parallel video sources.

        config THERMAL_HSYNC_INVERT
            bool "Invert HSYNC polarity"
            default y

        config THERMAL_DE_MODE
            int "Data-enable (DE) mode (0=HREF, 1=HREF inverted, 2=free-run)"
            default 2
            range 0 2
            help
                How the HSYNC pin gates valid pixels:
                  0 = HREF, active-high during valid pixels (driver default)
                  1 = HREF, inverted
                  2 = free-run: ignore HSYNC, capture every PCLK between VSYNCs
                If the image is sheared/garbled use mode 2; if blank, sweep with
                the D key on the console.

    endmenu

    menu "DVP GPIO Pins"

        comment "D0 = LSB (bit 0), D13 = MSB (bit 13).  D14/D15 must be tied to GND."

        config DVP_PCLK_GPIO
            int "PCLK GPIO"
            default 48

        config DVP_VSYNC_GPIO
            int "VSYNC GPIO"
            default 49

        config DVP_HSYNC_GPIO
            int "HSYNC GPIO"
            default 50

        config DVP_D0_GPIO
            int "D0 GPIO  (bit  0)"
            default 15

        config DVP_D1_GPIO
            int "D1 GPIO  (bit  1)"
            default 14

        config DVP_D2_GPIO
            int "D2 GPIO  (bit  2)"
            default 13

        config DVP_D3_GPIO
            int "D3 GPIO  (bit  3)"
            default 12

        config DVP_D4_GPIO
            int "D4 GPIO  (bit  4)"
            default 11

        config DVP_D5_GPIO
            int "D5 GPIO  (bit  5)"
            default 10

        config DVP_D6_GPIO
            int "D6 GPIO  (bit  6)"
            default 9

        config DVP_D7_GPIO
            int "D7 GPIO  (bit  7)"
            default 6

        config DVP_D8_GPIO
            int "D8 GPIO  (bit  8)"
            default 5

        config DVP_D9_GPIO
            int "D9 GPIO  (bit  9)"
            default 4

        config DVP_D10_GPIO
            int "D10 GPIO (bit 10)"
            default 3

        config DVP_D11_GPIO
            int "D11 GPIO (bit 11)"
            default 54

        config DVP_D12_GPIO
            int "D12 GPIO (bit 12)"
            default 53

        config DVP_D13_GPIO
            int "D13 GPIO (bit 13)"
            default 52

    endmenu

endmenu
```

## sdkconfig.defaults
```kconfig
# ESP32-P4 thermal UVC bridge — deliberate config on top of IDF defaults.
# Regenerates sdkconfig after `idf.py fullclean` or on a fresh checkout.

# PSRAM (32MB hex mode on Olimex board) — frame buffers live here
CONFIG_SPIRAM=y
CONFIG_SPIRAM_MODE_HEX=y
CONFIG_SPIRAM_SPEED_200M=y

# Performance
CONFIG_COMPILER_OPTIMIZATION_PERF=y
CONFIG_IDF_EXPERIMENTAL_FEATURES=y

# USB Device - High Speed
CONFIG_TINYUSB_RHPORT_HS=y
CONFIG_TINYUSB_VIDEO_STREAMING_IFS=1

# USB task: high priority on CPU1, video task on CPU0
CONFIG_UVC_TINYUSB_TASK_PRIORITY=24
CONFIG_UVC_TINYUSB_TASK_CORE=1
CONFIG_UVC_CAM1_TASK_PRIORITY=23
CONFIG_UVC_CAM1_TASK_CORE=0

# FreeRTOS: 1000Hz tick for minimal scheduling latency
CONFIG_FREERTOS_HZ=1000

# ---------------------------------------------------------------------------
# Wi-Fi via ESP-Hosted: the P4 has no radio, the on-module ESP32-C6 is the
# coprocessor and SDIO is the link. Pins are the JC-ESP32P4-M3 wiring; they
# happen to match Espressif's P4-Function-EV-Board preset, but are set
# explicitly here so the board choice stays "none" and the wiring is visible.
# None of these collide with the DVP pins (30-48) or camera UART1 (28/29).
# ---------------------------------------------------------------------------
CONFIG_ESP_HOSTED_CP_TARGET_ESP32C6=y
CONFIG_ESP_HOSTED_HOST_TRANSPORT_BUS_SDIO=y
CONFIG_ESP_HOSTED_HOST_SDIO_PIN_CLK=18
CONFIG_ESP_HOSTED_HOST_SDIO_PIN_CMD=19
CONFIG_ESP_HOSTED_HOST_SDIO_PIN_D0=14
CONFIG_ESP_HOSTED_HOST_SDIO_PIN_D1=15
CONFIG_ESP_HOSTED_HOST_SDIO_PIN_D2=16
CONFIG_ESP_HOSTED_HOST_SDIO_PIN_D3=17
CONFIG_ESP_HOSTED_HOST_RESET_GPIO=54
CONFIG_ESP_HOSTED_HOST_SDIO_BUS_WIDTH_4=y
CONFIG_ESP_HOSTED_HOST_SDIO_CLK_KHZ=40000
# Matches the CP side (see c6_firmware/sdkconfig.defaults for why 20 was not
# enough): deeper queues so the host hits the tick-quantised credit backoff in
# sdio_is_write_buffer_available() less often.
CONFIG_ESP_HOSTED_HOST_SDIO_TX_Q_SIZE=64
CONFIG_ESP_HOSTED_HOST_SDIO_RX_Q_SIZE=64

# Wi-Fi needs NVS for calibration/config storage
CONFIG_NVS_ENCRYPTION=n

# ---------------------------------------------------------------------------
# lwIP TCP windows, sized for the ESP-Hosted round trip.
#
# The stock 5760-byte send buffer caps throughput at window/RTT. ESP-Hosted
# puts an SDIO round trip in series with the air, measured at ~14 ms RTT here,
# which pinned TCP at ~3.3 Mbit/s regardless of signal strength (-51 dBm) or
# CPU load. The bus itself does 55 Mbit/s, so the window was the whole story.
# esp_hosted's own coprocessor example ships these same values commented out.
# ---------------------------------------------------------------------------
CONFIG_LWIP_TCP_SND_BUF_DEFAULT=65535
CONFIG_LWIP_TCP_WND_DEFAULT=65535
CONFIG_LWIP_TCP_RECVMBOX_SIZE=64
CONFIG_LWIP_TCPIP_RECVMBOX_SIZE=64
CONFIG_LWIP_TCP_SACK_OUT=y

# Custom partition table: 3 MB app (Wi-Fi had filled the stock 1 MB to 82%)
# plus a 2 MB c6_fw partition holding the ESP32-C6 coprocessor images.
CONFIG_PARTITION_TABLE_CUSTOM=y
CONFIG_PARTITION_TABLE_CUSTOM_FILENAME="partitions.csv"

# Console on the built-in USB-Serial-JTAG port (logs + the esp_console REPL).
# NOT UART0: that is GPIO37/38, which this board wires to DVP D11/D10, so a
# UART console would drive a DVP data line while printing.
CONFIG_ESP_CONSOLE_USB_SERIAL_JTAG=y
```
